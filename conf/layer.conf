## conf/layer.conf
```bitbake
# We have a conf and classes directory, add to BBPATH
BBPATH .= ":${LAYERDIR}"

# We have recipes-* directories, add to BBFILES
BBFILES += "${LAYERDIR}/recipes-*/*/*.bb \
            ${LAYERDIR}/recipes-*/*/*.bbappend"

BBFILE_COLLECTIONS += "cg5317"
BBFILE_PATTERN_cg5317 = "^${LAYERDIR}/"
BBFILE_PRIORITY_cg5317 = "50"

LAYERDEPENDS_cg5317 = "core"
LAYERSERIES_COMPAT_cg5317 = "scarthgap"
```
